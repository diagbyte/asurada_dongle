## Kconfig
```kconfig
# All Asurada options are display-shield specific. Scope the whole block to the
# shield so these symbols (and ASURADA_TOUCH's `select INPUT_CST816S`) never leak
# into unrelated builds sharing the west workspace, e.g. split peripherals.
if SHIELD_ASURADA_ADAPTER

# Only the Asurada layout ships in this repo now (the Prospector-derived classic/
# radii/field/operator layouts were removed). Kept as a promptable option defaulting
# on -- it must stay user-settable because configs (e.g. totem_dongle.conf) assign
# CONFIG_ASURADA_STATUS_SCREEN_ASURADA=y, and Zephyr errors on assigning a symbol
# that has no prompt.
config ASURADA_STATUS_SCREEN_ASURADA
    bool "Asurada status screen layout"
    default y

config ASURADA_ROTATE_DISPLAY_180
    bool "Rotate the display 180 degrees"
    default n

config ASURADA_LAYER_NAME_UPPERCASE
    bool "Display layer names in uppercase"
    default y
    help
      When enabled, layer names will be converted to uppercase for display.

#
# Brightness (no ambient light sensor; controlled by a fixed level + touch swipes)
#
config ASURADA_FIXED_BRIGHTNESS
    int "Display brightness (percent)"
    default 60
    range 1 100
    help
      Initial display backlight brightness. Adjustable at runtime with
      up/down touch swipes when ASURADA_TOUCH is enabled.

config ASURADA_BRIGHTNESS_STEP
    int "Brightness step per swipe (percent)"
    default 10
    range 1 50

#
# CST816S capacitive touch + gestures
#
config ASURADA_TOUCH
    bool "Enable CST816S touch input and gestures"
    default y
    select INPUT
    select INPUT_CST816S
    help
      Enables the CST816S touch controller and gesture handling:
      tap to wake and to cycle carousel pages, long-press to show the
      screensaver. (Swipe up/down for brightness and left/right for pages
      exist too, but the CST816S often doesn't report drag reliably.)

config ASURADA_TOUCH_SWIPE_THRESHOLD
    int "Minimum swipe distance in pixels"
    default 30
    range 10 120
    depends on ASURADA_TOUCH

#
# Idle screensaver: the Asurada four eyes
#
config ASURADA_SCREENSAVER
    bool "Show the Asurada four-eyes screensaver when idle"
    default y
    help
      On idle, show the animated Asurada four-eyes face instead of blanking
      the display. The eyes blink and glance around.

config ASURADA_SCREENSAVER_BRIGHTNESS
    int "Screensaver display brightness (percent)"
    default 15
    range 1 100
    depends on ASURADA_SCREENSAVER

config ASURADA_DISPLAY_OFF_MINUTES
    int "Minutes idle before the display sleeps (backlight off; 0 = never)"
    default 10
    range 0 240
    depends on ASURADA_SCREENSAVER
    help
      After this many minutes on the idle eyes screen with no activity, turn
      the backlight off and freeze the eyes to save power. Any key or a tap
      wakes it. The SoC stays up so USB / BLE relay keeps working.

config ASURADA_TRACKBALL_LOG
    bool "Log forwarded trackball REL events (Phase-1 bring-up)"
    default n
    help
      Emits an INFO log line per forwarded trackball INPUT_EV_REL event.
      Use to confirm motion reaches the dongle display, then turn off.

config ASURADA_AUTO_PAGE_FOLLOW
    bool "Auto-switch the display page to the active input device"
    depends on ASURADA_STATUS_SCREEN_ASURADA
    default y
    help
      Trackball motion shows the trackball page; typing shows the keyboard
      page. Reliable input-driven navigation that does not depend on the touch
      panel (whose swipe support is flaky on some CST816S modules). Set to n if
      you prefer to stay on a page and navigate only by touch swipe.

config ASURADA_TRACKBALL
    bool "Trackball features (rolling-ball page, pointing-mode text, trackball battery)"
    default y
    help
      Enable the trackball carousel page (the rolling red ball, the SCROLL/SNIPE
      pointing-mode text, and the trackball's battery) plus tapping the forwarded
      pointer input. Turn OFF for a keyboard-only dongle: the carousel becomes two
      pages (keyboard + connections) and no trackball code is built.

config ASURADA_TRACKBALL_SLOT
    int "Split peripheral slot index that is the trackball (its battery shows on the trackball page)"
    default 2
    depends on ASURADA_TRACKBALL
    help
      Which split-central peripheral slot the trackball bonds to (same index as
      the Connections page row). Confirm on hardware; change if the trackball
      battery shows on the wrong slot.

#
# Pointing-mode indicator (trackball page): SCROLL / SNIPE text driven by
# whichever pointing layer is active. The indices are keymap-specific, so
# they're exposed as Kconfig instead of hard-wired to one keymap. Only meaningful
# with the trackball page, so they depend on ASURADA_TRACKBALL.
#
config ASURADA_SCROLL_LAYER
    int "Keymap layer index that means SCROLL (shown on the trackball page)"
    default 6
    depends on ASURADA_TRACKBALL

config ASURADA_SCROLL_LAYER2
    int "Second SCROLL layer index (scroll-keep); set = SCROLL layer to disable"
    default 7
    depends on ASURADA_TRACKBALL

config ASURADA_SNIPE_LAYER
    int "Keymap layer index that means SNIPE"
    default 8
    depends on ASURADA_TRACKBALL

#
# Connections page: one row per split peripheral (Left/Right/trackball/...),
# labeled from these strings. Rendered row count follows the actual peripheral
# count at build time; unused labels are simply not shown.
#
config ASURADA_CONN_LABEL_0
    string "Connections page label for split peripheral slot 0"
    default "Left"

config ASURADA_CONN_LABEL_1
    string "Connections page label for split peripheral slot 1"
    default "Right"

config ASURADA_CONN_LABEL_2
    string "Connections page label for split peripheral slot 2"
    default "Trackball"

config ASURADA_CONN_LABEL_3
    string "Connections page label for split peripheral slot 3"
    default "Periph 4"

endif # SHIELD_ASURADA_ADAPTER
```

## boards/shields/asurada_adapter/Kconfig.defconfig
```kconfig
if SHIELD_ASURADA_ADAPTER

config ZMK_SPLIT_BLE_CENTRAL_BATTERY_LEVEL_FETCHING
    default y

config ZMK_DISPLAY
   default y

# When the Asurada screensaver is enabled, keep the panel powered on idle so we
# can draw the four eyes instead of blanking; brightness dimming is handled by
# the screensaver itself.
config ZMK_DISPLAY_BLANK_ON_IDLE
    default n if ASURADA_SCREENSAVER

choice ZMK_DISPLAY_STATUS_SCREEN
    default ZMK_DISPLAY_STATUS_SCREEN_CUSTOM
endchoice

rsource "src/layouts/*/Kconfig.defconfig"

choice ZMK_DISPLAY_WORK_QUEUE
    default ZMK_DISPLAY_WORK_QUEUE_DEDICATED
endchoice

config LV_Z_VDB_SIZE
    default 50

config LV_Z_DOUBLE_VDB
    default y

config LV_Z_FLUSH_THREAD
    default y

config LV_Z_MEM_POOL_SIZE
    default 16384

config LV_DPI_DEF
    default 261

config LV_Z_BITS_PER_PIXEL
	default 16

choice LV_COLOR_DEPTH
	default LV_COLOR_DEPTH_16
endchoice

config LV_COLOR_16_SWAP
	default y

choice LV_FONT_DEFAULT
    default LV_FONT_DEFAULT_MONTSERRAT_20
endchoice

config PWM
    default y

config LED
    default y

endif
```

## boards/shields/asurada_adapter/Kconfig.shield
```kconfig
config SHIELD_ASURADA_ADAPTER
    def_bool $(shields_list_contains,asurada_adapter)
```

## boards/shields/asurada_adapter/src/layouts/asurada/Kconfig.defconfig
```kconfig
if ASURADA_STATUS_SCREEN_ASURADA

config ZMK_DISPLAY_STATUS_SCREEN_CUSTOM
    select LV_USE_LABEL
    select LV_USE_FLEX
    select LV_USE_ARC
    select LV_USE_BAR
    select LV_USE_CANVAS
    select LV_COLOR_SCREEN_TRANSP

config ZMK_WPM
    default y

# Host CapsLock/NumLock LED state for the keyboard-page lock_status widget.
config ZMK_HID_INDICATORS
    default y

# Small built-in fonts for compact labels (L/R battery, trackball button legend).
config LV_FONT_MONTSERRAT_14
    default y

config LV_FONT_MONTSERRAT_12
    default y

# Bumped 20000 -> 32768: the trackball button legend + pulse objects overran the
# pool, so the display stalled and boot got stuck on the splash.
config LV_Z_MEM_POOL_SIZE
    default 32768

endif
```
